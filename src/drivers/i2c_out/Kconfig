## src/drivers/i2c_out/Kconfig
```kconfig
menuconfig DRIVERS_I2C_OUT
	bool "i2c_out"
	default n
	---help---
		Enable support for i2c_out
```

## src/drivers/transporter/Kconfig
```kconfig
menuconfig DRIVERS_TRANSPORTER
	bool "actuator_transporter_i2c"
	default n
	---help---
		Enable support for actuator_transporter_i2c
```

## src/examples/tvmd_app/Kconfig
```kconfig
 menuconfig EXAMPLES_TVMD_APP
    bool "TVMD app"
    default n
    ---help---
        Enable TVMD app
```

## src/modules/pfa_att_control/Kconfig
```kconfig
menuconfig MODULES_PFA_ATT_CONTROL
	bool "pfa_att_control"
	default n
	---help---
		Enable support for pfa_att_control

menuconfig USER_PFA_ATT_CONTROL
	bool "pfa_att_control running as userspace module"
	default y
	depends on BOARD_PROTECTED && MODULES_PFA_ATT_CONTROL
	---help---
		Put pfa_att_control in userspace memory
```

## src/modules/pfa_pos_control/Kconfig
```kconfig
menuconfig MODULES_PFA_POS_CONTROL
	bool "pfa_pos_control"
	default n
	---help---
		Enable support for pfa_pos_control

menuconfig USER_PFA_POS_CONTROL
	bool "pfa_pos_control running as userspace module"
	default y
	depends on BOARD_PROTECTED && MODULES_PFA_POS_CONTROL
	---help---
		Put pfa_pos_control in userspace memory
```
